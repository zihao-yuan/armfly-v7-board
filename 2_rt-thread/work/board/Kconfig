## 2_rt-thread/work/board/Kconfig
```kconfig
menu "Hardware Drivers Config"

config SOC_STM32H743XI
    bool
    select SOC_SERIES_STM32H7
    select RT_USING_COMPONENTS_INIT
    select RT_USING_USER_MAIN
    default y

menu "Onboard Peripheral Drivers"

endmenu

menu "On-chip Peripheral Drivers"

    config BSP_USING_GPIO
        bool "Enable GPIO"
        select RT_USING_PIN
        default y

    menuconfig BSP_USING_UART
        bool "Enable UART"
        default y
        select RT_USING_SERIAL
        if BSP_USING_UART
            config BSP_USING_UART1
                bool "Enable UART1"
                default y
            config BSP_UART1_RX_USING_DMA
                bool "Enable UART1 RX DMA"
                depends on BSP_USING_UART1 && RT_SERIAL_USING_DMA
                default n

            config BSP_UART1_TX_USING_DMA
                bool "Enable UART1 TX DMA"
                depends on BSP_USING_UART1 && RT_SERIAL_USING_DMA
                default n
                
            config BSP_USING_UART3
                bool "Enable UART3"
                default n
                
            config BSP_USING_UART4
                bool "Enable UART4"
                default n
                
            config BSP_USING_UART6
                bool "Enable UART6"
                default n
        endif

        config BSP_USING_SDRAM
        bool "Enable SDRAM"
        default n
        
    source "libraries/HAL_Drivers/Kconfig"
    
endmenu

menu "Board extended module Drivers"

endmenu
 
endmenu
```
